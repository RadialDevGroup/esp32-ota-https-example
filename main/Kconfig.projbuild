## main/Kconfig.projbuild
```kconfig
menu "Example Configuration"

config WIFI_SSID
    string "WiFi SSID"
	default "myssid"
	help
		SSID (network name) for the example to connect to.

config WIFI_PASSWORD
    string "WiFi Password"
	default "myssid"
	help
		WiFi password (WPA or WPA2) for the example to use.

		Can be left blank if the network has no security set.

config SERVER_DNS
    string "HTTP Server DNS"
	default "www.example.com"
	help
		HTTP Server DNS address to download the image file from.

		See example README.md for details.

config SERVER_PORT
	string "HTTP Server Port"
	default "443"
	help
		HTTP Server port to connect to.
		Should be chosen not to conflict with any other port used
		on the system.

config EXAMPLE_FILENAME
	string "HTTP GET Filename"
	default "/hello-world.bin"
	help
		Filename of the app image file to download for
		the OTA update.

endmenu
```
